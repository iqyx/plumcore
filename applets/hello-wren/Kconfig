## ports/nwdaq-inc5/Kconfig
```kconfig
config PORT_NWDAQ_INC5
	bool "nwdaq-inc5 single-axis inclination sensing module"

	menu "Configuraton"
		depends on PORT_NWDAQ_INC5

		config PORT_NAME
			string
			default "nwdaq-inc5"

		config PLATFORM_NAME
			string
			default "cortex-m4f"

		config MCU_FAMILY
			string
			default "stm32g4"

		config PORT_FLASH_ADDRESS
			hex
			default "0x08000000"

		config PORT_NWDAQ_INC5_MIB_PUBKEY
			string "Ed25519 public key for MIB verification (base64)"
			default ""
	endmenu
```

## ports/nwdaq-m-ff14/Kconfig
```kconfig
config PORT_NWDAQ_M_FF14
	bool "nwdaq-m-ff14 4-channel resistive force sensor digitizer"

	menu "Configuraton"
		depends on PORT_NWDAQ_M_FF14

		config PORT_NAME
			string
			default "nwdaq-m-ff14"

		config PLATFORM_NAME
			string
			default "cortex-m4f"

		config MCU_FAMILY
			string
			default "stm32g4"

		config PORT_FLASH_ADDRESS
			hex
			default "0x08000000"

		config PORT_NWDAQ_M_FF14_MIB_PUBKEY
			string "Ed25519 public key for MIB verification (base64)"
			default ""
	endmenu
```

## ports/nwdaq-m-gnss2/Kconfig
```kconfig
config PORT_NWDAQ_M_GNSS2
	bool "nwdaq-m-gnss2 GNSS, L-band and UHF receiver"

	menu "Configuraton"
		depends on PORT_NWDAQ_M_GNSS2

		config PORT_NAME
			string
			default "nwdaq-m-gnss2"

		config PLATFORM_NAME
			string
			default "cortex-m4f"

		config MCU_FAMILY
			string
			default "stm32g4"

		config PORT_FLASH_ADDRESS
			hex
			default "0x08000000"
	endmenu
```

## ports/nwdaq-main-hh1/Kconfig
```kconfig
config PORT_NWDAQ_MAIN_HH1
	bool "nwdaq-main-hh1 basic port (STM32U575VIT6)"
	select PORT_PLATFORM_ARM_CM33
	select SERVICE_STM32_OCTOSPI_FLASH
	select SERVICE_STM32_TIMER
	select SERVICE_PWM_BEEPER
	select SERVICE_PCAL6408A_GPIO
	select SERVICE_GPIO_KEYPAD
	select SERVICE_KEYPAD_LAYOUT

	menu "Configuraton"
		depends on PORT_NWDAQ_MAIN_HH1

		config PORT_NAME
			string
			default "nwdaq-main-hh1"

		config PLATFORM_NAME
			string
			default "cortex-m33"

		config MCU_FAMILY
			string
			default "stm32u5"

		config PORT_FLASH_ADDRESS
			hex
			default "0x08000000"
	endmenu
```

## ports/nwdaq-p-li200/Kconfig
```kconfig
config PORT_NWDAQ_P_LI200
	bool "nwdaq-p-li200 battery plugin unit"

	menu "Configuraton"
		depends on PORT_NWDAQ_P_LI200

		config PORT_NAME
			string
			default "nwdaq-p-li200"

		config PLATFORM_NAME
			string
			default "cortex-m4f"

		config MCU_FAMILY
			string
			default "stm32g4"

		config PORT_FLASH_ADDRESS
			hex
			default "0x08000000"
	endmenu
```

## ports/nwdaq-p-pg1/Kconfig
```kconfig
config PORT_NWDAQ_P_PG1
	bool "nwDaq p-pg1 power-grid switch"

	menu "Configuraton"
		depends on PORT_NWDAQ_P_PG1

		config PORT_NAME
			string
			default "nwdaq-p-pg1"

		config PLATFORM_NAME
			string
			default "cortex-m4f"

		config MCU_FAMILY
			string
			default "stm32g4"

		config PORT_FLASH_ADDRESS
			hex
			default "0x08000000"
	endmenu
```

## ports/nwdaq-s2-inc2/Kconfig
```kconfig
config PORT_NWDAQ_S2_INC2
	bool "nwdaq-s2-inc2 inclination sensing module for the S2 platform"

	menu "Configuraton"
		depends on PORT_NWDAQ_S2_INC2

		config PORT_NAME
			string
			default "nwdaq-s2-inc2"

		config PLATFORM_NAME
			string
			default "cortex-m4f"

		config MCU_FAMILY
			string
			default "stm32g4"

		config PORT_FLASH_ADDRESS
			hex
			default "0x08000000"

		config PORT_NWDAQ_S2_INC2_MIB_PUBKEY
			string "Ed25519 public key for MIB verification (base64)"
			default ""
	endmenu
```

## ports/nwdaq-s2-main-g4/Kconfig
```kconfig
config PORT_NWDAQ_S2_MAIN_G4
	bool "nwdaq-s2-main-g4 main module for the S2 platform"

	menu "Configuraton"
		depends on PORT_NWDAQ_S2_MAIN_G4

		config PORT_NAME
			string
			default "nwdaq-s2-main-g4"

		config PLATFORM_NAME
			string
			default "cortex-m4f"

		config MCU_FAMILY
			string
			default "stm32g4"

		config PORT_FLASH_ADDRESS
			hex
			default "0x08000000"
	endmenu
```
