## applets/hello-wren/Kconfig
```kconfig
config APPLET_HELLO_WREN
	bool "Hello world test applet (Wren)"
	select SERVICE_APPLET_RUNNER_WREN
```

## applets/settings/Kconfig
```kconfig
config APPLET_SETTINGS
	bool "Settings applet"
	depends on SERVICE_FB_PAINTER
	depends on LIB_PLUMCORE_CONFIGLIB
```

## applications/hh1/Kconfig
```kconfig
config APP_HH1
	bool "nwdaq-main-hh1 battery monitor application"

menu "nwdaq-main-hh1 application configuration"
	depends on APP_HH1

	config APP_NAME
		string
		default "hh1"

	choice
		prompt "Application profile"
		default APP_HH1_PROFILE_NONE

		config APP_HH1_PROFILE_NONE
			bool "None"

		config APP_HH1_PROFILE_FF14_FORCE
			bool "Force measurement using nwdaq-ate-ff14"
			select SERVICE_NBUS2
			select SERVICE_PROTO_DGSTREAM
			select SERVICE_NBUS_MQ_CLIENT
			select SERVICE_NBUS_FLASH_PROXY
			select SERVICE_MQ_COMPENSATION
	endchoice

endmenu
```

## applications/hmi-generic/Kconfig
```kconfig
config APP_HMI_GENERIC
	bool "A generic HMI application with LCD, presence detection, speaker, keyboard"

menu "Generic HMI application config"
	depends on APP_HMI_GENERIC

	config APP_NAME
		string
		default "hmi-generic"

endmenu
```

## applications/inc5/Kconfig
```kconfig
config APP_INC5
	bool "nwdaq-inc5 inclination measurement application"

menu "inc5 application configuration"
 	depends on APP_INC5

	config APP_NAME
		string
		default "inc5"

endmenu
```

## applications/meas-generic/Kconfig
```kconfig
config APP_MEAS_GENERIC
	bool "meas-generic generic measurement device application"

menu "meas-generic application configuration"
	depends on APP_MEAS_GENERIC

	config APP_NAME
		string
		default "meas-generic"

	config APP_MEAS_GENERIC_MAX_SENSORS
		int "Maximum number of measurement sensors"
		default 8

	config APP_MEAS_GENERIC_SENSORS
		string "Comma-separated list of sensor names to sample and publish"
		default "ch0,ch1,ch2,ch3"

	config APP_MEAS_GENERIC_TEMP_SENSOR
		string "Optional temperature sensor name feeding the compensation (empty to disable)"
		default ""

	config APP_MEAS_GENERIC_SAMPLE_INTERVAL_MS
		int "Sampling interval in milliseconds"
		default 100

	choice
		prompt "ADC measure unit"
		default APP_MEAS_GENERIC_MEASURE_UNIT_COUNTS

		config APP_MEAS_GENERIC_MEASURE_UNIT_COUNTS
			bool "Counts"

		config APP_MEAS_GENERIC_MEASURE_UNIT_RESISTANCE
			bool "Ratiometric resistance divider"
	endchoice

	config APP_MEAS_GENERIC_ADC_BITS
		int "ADC resolution in bits"
		depends on APP_MEAS_GENERIC_MEASURE_UNIT_RESISTANCE

	choice
		prompt "ADC input type"
		depends on APP_MEAS_GENERIC_MEASURE_UNIT_RESISTANCE

		config APP_MEAS_GENERIC_ADC_SINGLE_ENDED
			bool "Single-ended"

		config APP_MEAS_GENERIC_ADC_DIFFERENTIAL
			bool "Differential"
	endchoice

	config APP_MEAS_GENERIC_REFERENCE_RESISTOR
		int "Reference resistor value (ohm)"
		depends on APP_MEAS_GENERIC_MEASURE_UNIT_RESISTANCE

	choice
		prompt "Reference resistor position"
		depends on APP_MEAS_GENERIC_MEASURE_UNIT_RESISTANCE

		config APP_MEAS_GENERIC_REFERENCE_ON_TOP
			bool "Reference is on top"

		config APP_MEAS_GENERIC_REFERENCE_ON_BOTTOM
			bool "Reference is on bottom"
	endchoice

	config APP_MEAS_GENERIC_NBUS_API
		bool "Export the configuration tree over nbus2 on the console"
		default y

	config APP_MEAS_GENERIC_TEDS
		bool "Enable TEDS over one-wire"
		default n

	choice
		prompt "TEDS data format"
		depends on APP_MEAS_GENERIC_TEDS
		default APP_MEAS_GENERIC_TEDS_FORMAT_PLUMCORE_CBOR

		config APP_MEAS_GENERIC_TEDS_FORMAT_PLUMCORE_CBOR
			bool "plumCore CBOR calibration data format"
	endchoice

	config APP_MEAS_GENERIC_TEDS_MAX_CHANNELS
		int "Maximum number of TEDS mux channels"
		depends on APP_MEAS_GENERIC_TEDS
		default 16

	config APP_MEAS_GENERIC_TEDS_PROBE_INTERVAL_MS
		int "TEDS probe interval in milliseconds"
		depends on APP_MEAS_GENERIC_TEDS
		default 1000

endmenu
```

## applications/sample-nbus2-service/Kconfig
```kconfig
config APP_SAMPLE_NBUS2_SERVICE
	bool "Sample nbus2 service application"

menu "Application configuration"
 	depends on APP_SAMPLE_NBUS2_SERVICE

	config APP_NAME
		string
		default "sample-nbus2-service"

endmenu
```

## config/nwdaq_main_hh1_defconfig
```kconfig
CONFIG_PORT_NWDAQ_MAIN_HH1=y
# CONFIG_SERVICE_STM32_WATCHDOG is not set
# CONFIG_SERVICE_STM32_RTC is not set
# CONFIG_SERVICE_STM32_DAC is not set
# CONFIG_SERVICE_STM32_SYSTEM_CLOCK is not set
# CONFIG_SERVICE_STM32_CLOCK is not set
CONFIG_SERVICE_STM32_UART=y
CONFIG_SERVICE_STM32_SPI=y
# CONFIG_SERVICE_SJA1105 is not set
# CONFIG_SERVICE_STM32_TIMER is not set
# CONFIG_SERVICE_STM32_FLASH is not set
CONFIG_SERVICE_STM32_I2C_MASTER=y
# CONFIG_SERVICE_STM32_ADC is not set
# CONFIG_SERVICE_STM32_I2C_SENSORS is not set
# CONFIG_SERVICE_UXB_MASTER is not set
# CONFIG_SERVICE_STM32_QSPI_FLASH is not set
# CONFIG_SERVICE_STM32_L4_PM is not set
CONFIG_SERVICE_GPIO_LED=y
CONFIG_SERVICE_LP581X_LED=y
CONFIG_SERVICE_LP586X_LED=y
CONFIG_SERVICE_BQ25798=y
CONFIG_SERVICE_BQ27441=y
CONFIG_SERVICE_LCD_ST7586=y
CONFIG_SERVICE_FB_CONSOLE=y
CONFIG_SERVICE_FB_COMPOSITOR=y
CONFIG_SERVICE_FB_PAINTER=y
CONFIG_SERVICE_GUI_WM_FS=y
CONFIG_SERVICE_NCN26010=y
CONFIG_SERVICE_ST67W611=y
# CONFIG_SERVICE_PWM_BEEPER is not set
# CONFIG_SERVICE_PCAL6408A_GPIO is not set
# CONFIG_SERVICE_FLASH_VOL_STATIC is not set
# CONFIG_SERVICE_FLASH_CBOR_MIB is not set
# CONFIG_SERVICE_MQ_COMPENSATION is not set
# CONFIG_SERVICE_MQ_CONVOLVE is not set
# CONFIG_SERVICE_NBUS2 is not set
# CONFIG_SERVICE_SENSOR_OVER_CAN is not set
# CONFIG_SERVICE_GSM_QUECTEL is not set
# CONFIG_SERVICE_SPI_FLASH is not set
# CONFIG_SERVICE_I2C_EEPROM is not set
# CONFIG_SERVICE_ADC_SENSOR is not set
# CONFIG_SERVICE_GENERIC_POWER is not set
# CONFIG_SERVICE_FS_SPIFFS is not set
# CONFIG_SERVICE_FLASH_FIFO is not set
# CONFIG_SERVICE_PLOG_ROUTER is not set
# CONFIG_SERVICE_USART_LOGGER is not set
# CONFIG_SERVICE_PLOG_PACKAGER is not set
# CONFIG_SERVICE_CLI is not set
# CONFIG_SERVICE_LORA_FS is not set
# CONFIG_SERVICE_MQTT_FILE_SERVER is not set
# CONFIG_SERVICE_STREAM_OVER_MQTT is not set
# CONFIG_SERVICE_MQTT_SENSOR_UPLOAD is not set
# CONFIG_SERVICE_MQTT_FILE_DOWNLOAD is not set
# CONFIG_SERVICE_PLOG_SENSOR_UPLOAD is not set
# CONFIG_SERVICE_PLOG_RELAY is not set
# CONFIG_SERVICE_MQ_WS_SOURCE is not set
# CONFIG_SERVICE_MQ_SENSOR_SOURCE is not set
# CONFIG_SERVICE_MQ_BATCH is not set
# CONFIG_SERVICE_MQ_STATS is not set
# CONFIG_SERVICE_MQ_PERIODOGRAM is not set
# CONFIG_SERVICE_TCPIP_SENSOR_UPLOAD is not set
# CONFIG_SERVICE_RADIO_MAC_SIMPLE is not set
# CONFIG_SERVICE_MQTT_TCPIP is not set
# CONFIG_SERVICE_NBUS_FLASH is not set
# CONFIG_SERVICE_FLASH_TEST is not set
# CONFIG_LIB_LINEEDIT is not set
# CONFIG_LIB_TREECLI is not set
# CONFIG_LIB_SPIFFS is not set
CONFIG_LIB_CMSIS=y
CONFIG_LIB_CMSIS_STM32U5=y
# CONFIG_LIB_ZFP is not set
# CONFIG_LIB_FEC_GOLAY is not set
# CONFIG_DEFAULT_MQTT_CONNECTION is not set
CONFIG_APP_HH1=y
CONFIG_APPLET_HELLO_WORLD=y
CONFIG_FW_IMAGE_ELF=y
CONFIG_ELF_IMAGE_LOAD_ADDRESS=0x08000000
```

## config/nwdaq_s2_inc2_defconfig
```kconfig
CONFIG_PORT_NWDAQ_S2_INC2=y
# CONFIG_SERVICE_STM32_RTC is not set
# CONFIG_SERVICE_STM32_SYSTEM_CLOCK is not set
# CONFIG_SERVICE_STM32_I2C_SENSORS is not set
# CONFIG_SERVICE_UXB_MASTER is not set
# CONFIG_SERVICE_STM32_I2C_MASTER is not set
# CONFIG_SERVICE_STM32_QSPI_FLASH is not set
# CONFIG_SERVICE_STM32_L4_PM is not set
CONFIG_SERVICE_NBUS2=y
# CONFIG_SERVICE_SENSOR_OVER_CAN is not set
# CONFIG_SERVICE_GSM_QUECTEL is not set
# CONFIG_SERVICE_SPI_FLASH is not set
# CONFIG_SERVICE_I2C_EEPROM is not set
# CONFIG_SERVICE_ADC_SENSOR is not set
CONFIG_SERVICE_ADC_MCP3564=y
CONFIG_SERVICE_GENERIC_POWER=y
# CONFIG_SERVICE_FS_SPIFFS is not set
# CONFIG_SERVICE_FLASH_FIFO is not set
CONFIG_SERVICE_CRASH_MGR=y
CONFIG_CRASH_MGR_ENABLE_BACKTRACE=y
# CONFIG_SERVICE_PLOG_PACKAGER is not set
# CONFIG_SERVICE_CLI_DEVICE_CAN is not set
# CONFIG_SERVICE_CLI_SYSTEM_BOOTLOADER is not set
# CONFIG_SERVICE_LORA_FS is not set
# CONFIG_SERVICE_MQTT_FILE_SERVER is not set
# CONFIG_SERVICE_STREAM_OVER_MQTT is not set
# CONFIG_SERVICE_MQTT_SENSOR_UPLOAD is not set
# CONFIG_SERVICE_MQTT_FILE_DOWNLOAD is not set
# CONFIG_SERVICE_PLOG_SENSOR_UPLOAD is not set
# CONFIG_SERVICE_PLOG_RELAY is not set
# CONFIG_SERVICE_MQ_WS_SOURCE is not set
# CONFIG_SERVICE_MQ_SENSOR_SOURCE is not set
# CONFIG_SERVICE_MQ_BATCH is not set
# CONFIG_SERVICE_MQ_STATS is not set
# CONFIG_SERVICE_MQ_PERIODOGRAM is not set
# CONFIG_SERVICE_TCPIP_SENSOR_UPLOAD is not set
# CONFIG_SERVICE_RADIO_MAC_SIMPLE is not set
# CONFIG_SERVICE_MQTT_TCPIP is not set
# CONFIG_SERVICE_FLASH_TEST is not set
# CONFIG_LIB_SPIFFS is not set
# CONFIG_LIB_CMSIS is not set
# CONFIG_LIB_ZFP is not set
# CONFIG_LIB_FEC_GOLAY is not set
# CONFIG_DEFAULT_MQTT_CONNECTION is not set
CONFIG_DEFAULT_CONSOLE_CLI=y
CONFIG_DEFAULT_PLOG_ROUTER=y
CONFIG_APP1=y
CONFIG_APPLET_HELLO_WORLD=y
CONFIG_FW_IMAGE_ELF=y
```

## config/nwdaq_s2_main_g4_bl_defconfig
```kconfig
CONFIG_PORT_NWDAQ_S2_MAIN_G4=y
# CONFIG_SERVICE_STM32_ADC is not set
# CONFIG_SERVICE_STM32_DAC is not set
# CONFIG_SERVICE_STM32_SYSTEM_CLOCK is not set
# CONFIG_SERVICE_STM32_I2C_SENSORS is not set
# CONFIG_SERVICE_UXB_MASTER is not set
# CONFIG_SERVICE_STM32_I2C_MASTER is not set
# CONFIG_SERVICE_STM32_QSPI_FLASH is not set
# CONFIG_SERVICE_STM32_L4_PM is not set
# CONFIG_SERVICE_SENSOR_OVER_CAN is not set
# CONFIG_SERVICE_GSM_QUECTEL is not set
# CONFIG_SERVICE_SPI_FLASH is not set
# CONFIG_SERVICE_I2C_EEPROM is not set
# CONFIG_SERVICE_ADC_SENSOR is not set
# CONFIG_SERVICE_FS_SPIFFS is not set
# CONFIG_SERVICE_FLASH_FIFO is not set
# CONFIG_SERVICE_PLOG_ROUTER is not set
CONFIG_SERVICE_CHAINLOADER=y
CONFIG_SERVICE_FLASH_UPDATER=y
# CONFIG_SERVICE_PLOG_PACKAGER is not set
# CONFIG_SERVICE_CLI is not set
# CONFIG_SERVICE_LORA_FS is not set
# CONFIG_SERVICE_MQTT_FILE_SERVER is not set
# CONFIG_SERVICE_STREAM_OVER_MQTT is not set
# CONFIG_SERVICE_MQTT_SENSOR_UPLOAD is not set
# CONFIG_SERVICE_MQTT_FILE_DOWNLOAD is not set
# CONFIG_SERVICE_PLOG_SENSOR_UPLOAD is not set
# CONFIG_SERVICE_PLOG_RELAY is not set
# CONFIG_SERVICE_MQ_WS_SOURCE is not set
# CONFIG_SERVICE_MQ_SENSOR_SOURCE is not set
# CONFIG_SERVICE_MQ_BATCH is not set
# CONFIG_SERVICE_MQ_STATS is not set
# CONFIG_SERVICE_MQ_PERIODOGRAM is not set
# CONFIG_SERVICE_TCPIP_SENSOR_UPLOAD is not set
# CONFIG_SERVICE_RADIO_MAC_SIMPLE is not set
# CONFIG_SERVICE_MQTT_TCPIP is not set
# CONFIG_SERVICE_FLASH_TEST is not set
CONFIG_LIB_HEATSHRINK=y
# CONFIG_LIB_SPIFFS is not set
# CONFIG_LIB_CMSIS is not set
# CONFIG_LIB_ZFP is not set
# CONFIG_LIB_FEC_GOLAY is not set
CONFIG_LIB_XZ_EMBEDDED=y
CONFIG_LIB_XZ_DEC_ARMTHUMB=y
# CONFIG_DEFAULT_MQTT_CONNECTION is not set
CONFIG_SHOW_BANNER=y
CONFIG_APP_BL=y
CONFIG_BL_PUBKEY="aqJQr7BPqj8x+KYDzOanZQT9zcMvIjn1QPJKMUVUeos="
CONFIG_FW_IMAGE_ELF=y
```

## lib/Kconfig
```kconfig
config LIB_LINEEDIT
	bool "lineedit (single-line editor library with command history)"
	default y

config LIB_NANOPB
	bool "NanoPB protocol buffers library"
	default y

config LIB_HEATSHRINK
	bool "Heatshrink LZSS compression/decompression library"
	default n

config LIB_TREECLI
	bool "treecli tree-structured command line interface library"
	default y

config LIB_DUKTAPE
	bool "duktape ECMAScript interpreter library"
	default n

config LIB_WREN
	bool "wren.io language compiler & VM"
	default n

if LIB_WREN

config LIB_WREN_MINIMAL_CORE
	bool "Strip rarely-used methods from the Wren core library"
	default n
	help
	  Removes several convenience methods from Wren's built-in (Wren-source) core
	  library to save heap, flash and startup compile stack on small MCUs:
	  List.sort/quicksort_/partition_, String.split/replace/trim*, and the
	  String.bytes/codePoints byte/code-point sequences. Dropping List.sort also
	  removes the deepest closure nesting in the core library, lowering the
	  compiler task's stack requirement. Basic iteration (for-in), the Sequence
	  helpers (map/where/reduce/each/count) and list/map literals are unaffected.

endif

config LIB_GRAVITY
	bool "Gravity language compiler & VM"
	default n

config LIB_PKPY
	bool "pocketpy Python interpreter & VM"
	default n

config LIB_SPIFFS
	bool "SPIFFS NOR flash memory filesystem library"
	default y

config LIB_CMSIS
	bool "ARM CMSIS library"
	default y

config LIB_CMSIS_DSP
	depends on LIB_CMSIS
	bool "ARM CMSIS DSP library"
	default n

config LIB_CMSIS_STM32H7
	bool "ARM CMSIS library for STM32H7 MCU family"
	default n

config LIB_CMSIS_STM32G4
	bool "ARM CMSIS library for STM32G4 MCU family"
	default n

config LIB_CMSIS_STM32U5
	bool "ARM CMSIS library for STM32U5 MCU family"
	default n

config LIB_ZFP
	bool "LLNL ZFP floating point compression library"
	default y

config LIB_TINYCBOR
	bool "CBOR encoding/decoding library TinyCbor"
	default y

config LIB_LIBOPENCM3
	bool "libopencm3 library"
	default y

config LIB_PLUMCORE_CRYPTOLIB
	bool "plumCore cryptographic primitives and routines"
	default y

config LIB_FEC_GOLAY
	bool "fec-golay library for Golay forward error correction"
	default y

config LIB_PLUMCORE_LOG
	bool "plumCore logging library"
	default y

config LIB_LITTLEFS
	bool "littlefs filesystem library"
	default n

config LIB_BLAKE2S_MICRO
	bool "blake2s-micro library"
	default n

config LIB_PLUMCORE_CONFIGLIB
	bool "plumCore configuration library/helpers"
	default y

config LIB_XZ_EMBEDDED
	bool "xz-embedded LZMA decompressor"
	default n

	menu "xz-embedded configuration"
		depends on LIB_XZ_EMBEDDED

		config LIB_XZ_DEC_ARM
			bool "BCJ filter decoder for ARM"
			default n

		config LIB_XZ_DEC_ARMTHUMB
			bool "BCJ filter decoder for ARMTHUMB"
			default n

		config LIB_XZ_DEC_ARM64
			bool "BCJ filter decoder for ARM64"
			default n

		config LIB_XZ_DEC_RISCV
			bool "BCJ filter decoder for RISCV"
			default n
	endmenu
```

## platforms/cortex-m33/Kconfig
```kconfig
config PORT_PLATFORM_ARM_CM33
	bool

menu "ARM Cortex M33 platform configuration"
	depends on PORT_PLATFORM_ARM_CM33

	# Placeholder
endmenu
```

## platforms/cortex-m7/Kconfig
```kconfig
config PORT_PLATFORM_ARM_CM7
	bool

menu "ARM Cortex M7 platform configuration"
	depends on PORT_PLATFORM_ARM_CM7

	# Placeholder
endmenu
```

## ports/bt-led-ctrl/Kconfig
```kconfig
config PORT_BT_LED_CTRL
	bool "BT LED light controller"

	menu "Configuraton"
		depends on PORT_BT_LED_CTRL

		config PORT_NAME
			string
			default "bt-led-ctrl"

		config PLATFORM_NAME
			string
			default "cortex-m4f"

		config MCU_FAMILY
			string
			default "stm32g4"

		config PORT_FLASH_ADDRESS
			hex
			default "0x08000000"
	endmenu
```

## ports/nwdaq-if-rs44/Kconfig
```kconfig
config PORT_NWDAQ_IF_RS44
	bool "nwdaq-ir-rs44 RS485 interface"

	menu "Configuraton"
		depends on PORT_NWDAQ_IF_RS44

		config PORT_NAME
			string
			default "nwdaq-if-rs44"

		config PLATFORM_NAME
			string
			default "cortex-m4f"

		config MCU_FAMILY
			string
			default "stm32g4"

		config PORT_FLASH_ADDRESS
			hex
			default "0x08000000"
	endmenu
```

## ports/nwdaq-if-sr1s/Kconfig
```kconfig
config PORT_NWDAQ_IF_SR1S
	bool "nwdaq-if-sr1s short-range interface with a 10Base-T1S switch"

	menu "Configuraton"
		depends on PORT_NWDAQ_IF_SR1S

		config PORT_NAME
			string
			default "nwdaq-if-sr1s"

		config PLATFORM_NAME
			string
			default "cortex-m4f"

		config MCU_FAMILY
			string
			default "stm32g4"

		config PORT_FLASH_ADDRESS
			hex
			default "0x08000000"

		config PORT_NWDAQ_IF_SR1S_MIB_PUBKEY
			string "Ed25519 public key for MIB verification (base64)"
			default ""
	endmenu
```
