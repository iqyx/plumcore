## applets/live-data/Kconfig
```kconfig
config APPLET_LIVE_DATA
	bool "Live data applet"
	depends on SERVICE_FB_PAINTER

config APPLET_LIVE_DATA_TOP_BAR_H
	int "Height of the top caption bar in pixels"
	depends on APPLET_LIVE_DATA
	default 20
```

## applets/updater/Kconfig
```kconfig
config APPLET_UPDATER
	bool "Firmware updater applet"
	depends on SERVICE_PROTO_HTTP
	select LIB_PLUMCORE_JSON

config APPLET_UPDATER_GUI
	bool "Graphical user interface of the updater applet"
	depends on APPLET_UPDATER && SERVICE_FB_PAINTER && SERVICE_GUI_WM_FS
```

## services/proto-http/Kconfig
```kconfig
config SERVICE_PROTO_HTTP
	bool "HTTP/1.1 client over a Tcp or Tls connection"
	default n
	select LIB_PLUMCORE_CRYPTOLIB

	config SERVICE_PROTO_HTTP_MAX_SESSIONS
		int "Maximum number of concurrent requests"
		default 1
		depends on SERVICE_PROTO_HTTP

	config SERVICE_PROTO_HTTP_BUF_SIZE
		int "Size of the per-session buffer holding the request head and the response headers (bytes)"
		default 512
		depends on SERVICE_PROTO_HTTP
```
