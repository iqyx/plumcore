## Kconfig
```kconfig
mainmenu "plumCore configuration"

choice
	prompt "Target board/device (port configuration)"
	source "ports/*/Kconfig"
endchoice


# Platform configuration determines *how* is the framework code compiled
# (eg. instruction set if multiple are supported, endianness, whether
# using FPU/soft-fpu..)
source "platforms/*/Kconfig"


menu "Microkernel (scheduler & IPC) configuration"
	choice
		prompt "Select the scheduler and IPC implementation to use as a microkernel"

		config KERNEL_FREERTOS
			bool "FreeRTOS"

		config KERNEL_CMRX
			bool "CMRX"
	endchoice

	source "microkernel/*.Kconfig"
endmenu


# Services are either board and platform dependent (device drivers)
# or independent (high level drivers, communication services, etc.).
# Multiple instances of the same service can be running.
menu "Service configuration"
	source "services/Kconfig"
endmenu


# The kernel and services depend on some external libraries.
# Download and patch them.
menu "Libraries"
	source "lib/Kconfig"
endmenu


# System part of the framework contains the whole startup logic.
# It configures the platform, microkernel, board and lets the application
# continue with the startup.
menu "System startup and configuration"
	source "system/Kconfig"
endmenu


# An application determines the particular usecase the device/board
# is used in. Theres always only a single application at a time
# running on the device. The application may specify multiple services
# to be run and even multiple instances of the same service if required.
# Applications are configurable and may contain optional components.
choice
	prompt "Application configuration"

	config APP_EXTERNAL
		bool "Application in external directory"

	menu "External application configuration"
		depends on APP_EXTERNAL
		source "$(PLUMCORE_EXT_APP)/Kconfig"
	endmenu

	source "applications/*/Kconfig"
endchoice


# Applets are short running application or scripts usually with
# user interraction (CLI, network)
menu "Applets"
	source "applets/*/Kconfig"
endmenu


# The build process itself is done in the *build* directory while
# the artifacts are moved to the *bin* directory.
menu "Build artifacts (firmware images)"
	menu "Output file name format"
		config OUTPUT_FILE_PREFIX
			string "Generic prefix of output file names"
			default "plumcore"

		config OUTPUT_FILE_PORT_PREFIX
			bool "Prefix port/board to output file names"
			default y

		config OUTPUT_FILE_APP_PREFIX
			bool "Prefix application name to output file names"
			default y

		config OUTPUT_FILE_VERSION_SUFFIX
			bool "Append the current version string to output file names"
			default y

		config OUTPUT_FILE_META_SUFFIX
			bool "Append metadata string to output file names"
			default y
	endmenu

	source "scripts/build_artifacts/Kconfig"
endmenu


menu "Communication settings"
	config GDB_REMOTE_TARGET
		string "Remote target configuration when using GDB to flash the device"
		default "tcp:localhost:3333"

endmenu
```

## applets/hello-world/Kconfig
```kconfig
config APPLET_HELLO_WORLD
	bool "Hello world test applet"

menu "App1 application configuration"
	depends on APPLET_HELLO_WORLD

	config APPLET_HELLO_WORLD_GREETING
		string "Greeting string"
		default "Welcome to the Hello world applet"

endmenu
```

## applets/tempco-calibration/Kconfig
```kconfig
config APPLET_TEMPCO_CALIBRATION
	bool "Output adc-composite temperature coeff calibration data as a CSV"

menu "tempco-calibration configuration"
	depends on APPLET_TEMPCO_CALIBRATION

endmenu
```

## applications/app1/Kconfig
```kconfig
config APP1
	bool "App1 test application"

menu "App1 application configuration"
 	depends on APP1

	config APP_NAME
		string
		default "app1"

	config APP1_VAR1
		bool "app1 variable"

endmenu
```

## applications/bootloader/Kconfig
```kconfig
config APP_BL
	bool "Bootloader application"

menu "Bootloader configuration"
 	depends on APP_BL

	config APP_NAME
		string
		default "bootloader"

	config BL_PUBKEY
		string "Ed25519 public key for firmware verification (base64)"

endmenu
```

## applications/nwdaq-br28-fdc-main-app/Kconfig
```kconfig
config APP_NWDAQ_BR28_FDC
	bool "nwdaq-br28-fdc main application"

menu "nwdaq-br28-fdc main application"
 	depends on APP_NWDAQ_BR28_FDC

	config APP_NAME
		string
		default "nwdaq-br28-fdc-main-app"

endmenu
```

## applications/nwdaq-rtd18-fdc-main-app/Kconfig
```kconfig
config APP_NWDAQ_RTD18_FDC
	bool "nwdaq-rtd18-fdc main application"

menu "nwdaq-rtd18-fdc main application"
 	depends on APP_NWDAQ_RTD18_FDC

	config APP_NAME
		string
		default "nwdaq-rtd18-fdc-main-app"

endmenu
```

## config/nwdaq_br28_fdc_bl_defconfig
```kconfig
CONFIG_PORT_NWDAQ_BR28_FDC=y
# CONFIG_SERVICE_STM32_ADC is not set
# CONFIG_SERVICE_STM32_DAC is not set
# CONFIG_SERVICE_STM32_I2C_SENSORS is not set
# CONFIG_SERVICE_UXB_MASTER is not set
# CONFIG_SERVICE_STM32_QSPI_FLASH is not set
# CONFIG_SERVICE_STM32_L4_PM is not set
# CONFIG_SERVICE_SENSOR_OVER_CAN is not set
# CONFIG_SERVICE_GSM_QUECTEL is not set
# CONFIG_SERVICE_ADC_SENSOR is not set
# CONFIG_SERVICE_FS_SPIFFS is not set
# CONFIG_SERVICE_FLASH_FIFO is not set
# CONFIG_SERVICE_FLASH_CBOR_MIB is not set
CONFIG_SERVICE_CHAINLOADER=y
# CONFIG_SERVICE_PLOG_PACKAGER is not set
# CONFIG_SERVICE_CLI is not set
# CONFIG_SERVICE_LORA_FS is not set
# CONFIG_SERVICE_MQTT_FILE_SERVER is not set
# CONFIG_SERVICE_STREAM_OVER_MQTT is not set
# CONFIG_SERVICE_MQTT_SENSOR_UPLOAD is not set
# CONFIG_SERVICE_MQTT_FILE_DOWNLOAD is not set
# CONFIG_SERVICE_PLOG_SENSOR_UPLOAD is not set
# CONFIG_SERVICE_PLOG_RELAY is not set
# CONFIG_SERVICE_MQ_WS_SOURCE is not set
# CONFIG_SERVICE_MQ_SENSOR_SOURCE is not set
# CONFIG_SERVICE_MQ_BATCH is not set
# CONFIG_SERVICE_MQ_STATS is not set
# CONFIG_SERVICE_MQ_PERIODOGRAM is not set
# CONFIG_SERVICE_TCPIP_SENSOR_UPLOAD is not set
# CONFIG_SERVICE_RADIO_MAC_SIMPLE is not set
# CONFIG_SERVICE_MQTT_TCPIP is not set
# CONFIG_SERVICE_FLASH_TEST is not set
# CONFIG_LIB_NANOPB is not set
# CONFIG_LIB_TREECLI is not set
# CONFIG_LIB_SPIFFS is not set
# CONFIG_LIB_CMSIS is not set
# CONFIG_LIB_ZFP is not set
# CONFIG_LIB_FEC_GOLAY is not set
# CONFIG_DEFAULT_MQTT_CONNECTION is not set
CONFIG_APP_BL=y
CONFIG_FW_IMAGE_ELF=y
```

## config/nwdaq_br28_fdc_defconfig
```kconfig
CONFIG_PORT_NWDAQ_BR28_FDC=y
CONFIG_NWDAQ_BR28_FDC_ENABLE_SERIAL_CONSOLE=y
CONFIG_NWDAQ_BR28_FDC_ENABLE_LEDS=y
CONFIG_NWDAQ_BR28_FDC_ENABLE_FLASH=y
# CONFIG_SERVICE_STM32_I2C_SENSORS is not set
# CONFIG_SERVICE_UXB_MASTER is not set
CONFIG_SERVICE_STM32_FDCAN=y
# CONFIG_SERVICE_STM32_L4_PM is not set
CONFIG_SERVICE_NBUS=y
# CONFIG_SERVICE_SENSOR_OVER_CAN is not set
# CONFIG_SERVICE_GSM_QUECTEL is not set
CONFIG_SERVICE_ADC_MCP3564=y
CONFIG_SERVICE_ADC_COMPOSITE=y
CONFIG_SERVICE_GENERIC_POWER=y
CONFIG_SERVICE_GENERIC_MUX=y
# CONFIG_SERVICE_CLI_DEVICE_CAN is not set
# CONFIG_SERVICE_CLI_SYSTEM_BOOTLOADER is not set
# CONFIG_SERVICE_LORA_FS is not set
# CONFIG_SERVICE_MQTT_FILE_SERVER is not set
# CONFIG_SERVICE_STREAM_OVER_MQTT is not set
# CONFIG_SERVICE_MQTT_SENSOR_UPLOAD is not set
# CONFIG_SERVICE_MQTT_FILE_DOWNLOAD is not set
# CONFIG_SERVICE_PLOG_SENSOR_UPLOAD is not set
# CONFIG_SERVICE_PLOG_RELAY is not set
# CONFIG_SERVICE_MQ_PERIODOGRAM is not set
# CONFIG_SERVICE_TCPIP_SENSOR_UPLOAD is not set
# CONFIG_SERVICE_RADIO_MAC_SIMPLE is not set
# CONFIG_SERVICE_MQTT_TCPIP is not set
# CONFIG_SERVICE_FLASH_TEST is not set
# CONFIG_LIB_LIBUXB is not set
# CONFIG_LIB_SFFS is not set
# CONFIG_LIB_ZFP is not set
# CONFIG_DEFAULT_MQTT_CONNECTION is not set
CONFIG_DEFAULT_CONSOLE_CLI=y
CONFIG_CONFIG_LOAD_FILE=y
CONFIG_CONFIG_LOAD_FILE_FILENAME="startup.cfg"
CONFIG_DEFAULT_PLOG_ROUTER=y
CONFIG_APP_NWDAQ_BR28_FDC=y
CONFIG_APPLET_HELLO_WORLD=y
CONFIG_APPLET_TEMPCO_CALIBRATION=y
CONFIG_FW_IMAGE_ELF=y
```

## config/nwdaq_if_lpcan_defconfig
```kconfig
CONFIG_PORT_NWDAQ_IF_CANLP=y
# CONFIG_SERVICE_STM32_DAC is not set
# CONFIG_SERVICE_STM32_I2C_SENSORS is not set
# CONFIG_SERVICE_UXB_MASTER is not set
# CONFIG_SERVICE_STM32_QSPI_FLASH is not set
# CONFIG_SERVICE_STM32_SPI is not set
CONFIG_SERVICE_STM32_FDCAN=y
# CONFIG_SERVICE_STM32_L4_PM is not set
CONFIG_SERVICE_NBUS=y
CONFIG_SERVICE_NBUS_SWITCH=y
# CONFIG_SERVICE_SENSOR_OVER_CAN is not set
# CONFIG_SERVICE_GSM_QUECTEL is not set
# CONFIG_SERVICE_ADC_SENSOR is not set
# CONFIG_SERVICE_CLI_DEVICE_CAN is not set
# CONFIG_SERVICE_CLI_SYSTEM_BOOTLOADER is not set
# CONFIG_SERVICE_LORA_FS is not set
# CONFIG_SERVICE_MQTT_FILE_SERVER is not set
# CONFIG_SERVICE_STREAM_OVER_MQTT is not set
# CONFIG_SERVICE_MQTT_SENSOR_UPLOAD is not set
# CONFIG_SERVICE_MQTT_FILE_DOWNLOAD is not set
# CONFIG_SERVICE_PLOG_SENSOR_UPLOAD is not set
# CONFIG_SERVICE_PLOG_RELAY is not set
# CONFIG_SERVICE_MQ_PERIODOGRAM is not set
# CONFIG_SERVICE_TCPIP_SENSOR_UPLOAD is not set
# CONFIG_SERVICE_RADIO_MAC_SIMPLE is not set
# CONFIG_SERVICE_MQTT_TCPIP is not set
# CONFIG_SERVICE_FLASH_TEST is not set
# CONFIG_LIB_LIBUXB is not set
# CONFIG_LIB_SFFS is not set
# CONFIG_LIB_ZFP is not set
# CONFIG_DEFAULT_MQTT_CONNECTION is not set
CONFIG_DEFAULT_CONSOLE_CLI=y
CONFIG_DEFAULT_PLOG_ROUTER=y
CONFIG_APP1=y
CONFIG_APPLET_HELLO_WORLD=y
CONFIG_FW_IMAGE_ELF=y
```

## platforms/cortex-m4f/Kconfig
```kconfig
config PORT_PLATFORM_ARM_CM4F
	bool

menu "ARM Cortex M4F platform configuration"
	depends on PORT_PLATFORM_ARM_CM4F
	
	# Placeholder
endmenu
```

## ports/incl-g104mf/Kconfig
```kconfig
config PORT_INCL_G104MF
	bool "incl-g104mf wireless accelerometer"
	select SERVICE_STM32_RTC
	select SERVICE_STM32_SYSTEM_CLOCK
	select SERVICE_PLOCATOR
	select PORT_PLATFORM_ARM_CM4F

	menu "Configuration"
		depends on PORT_INCL_G104MF

		config PORT_NAME
			string
			default "incl-g104mf"

		config PLATFORM_NAME
			string
			default "cortex-m4f"

		config PORT_FLASH_ADDRESS
			hex
			default "0x08000000"

		choice
			prompt "Clock speed"

			config INCL_G104MF_CLOCK_HSI16
				bool "16 MHz (using HSI16)"
		endchoice

		config INCL_G104MF_ENABLE_LEDS
			bool "Enable LEDs"
			default n

		config INCL_G104MF_ENABLE_WATCHDOG
			bool "Enable watchdog"
			select SERVICE_STM32_WATCHDOG
			default y

		config STM32_DEBUG_IN_STOP
			bool "Enable debugging in stop mode"
			default y

		config INCL_G104MF_ENABLE_QSPI
			select SERVICE_STM32_QSPI_FLASH
			bool "Enable QSPI NOR flash (FIFO for measured data, SPIFFS for firmware update & configuratio)"
			default y

		config INCL_G104MF_QSPI_STARTUP_TEST
			depends on INCL_G104MF_ENABLE_QSPI
			select SERVICE_FLASH_TEST
			bool "Run QSPI speed test on startup"
			default n

			comment "Warning: running flash tests on every boot wears out the flash memory faster"
				depends on INCL_G104MF_QSPI_STARTUP_TEST

		config INCL_G104MF_ENABLE_CONSOLE
			select SERVICE_STM32_UART
			select SERVICE_CLI
			select SERVICE_LOGINMGR
			bool "Enable serial console"
			default y

			config INCL_G104MF_CONSOLE_SPEED
				depends on INCL_G104MF_ENABLE_CONSOLE
				int "Console speed (baudrate)"
				default 115200

		config INCL_G104MF_ENABLE_LORA
			select SERVICE_LORA_RN2483
			bool "Enable RN2483 LoRaWAN modem"
			default y

		config INCL_G104MF_ENABLE_RFM
			bool "Enable RFMxx LoRa modem transceiver"
			default y

		config INCL_G104MF_ENABLE_TDK_ACCEL
			bool "Enable ICM-42688 accelerometer"
			default y

		config INCL_G104MF_ENABLE_ADXL_ACCEL
			bool "Enable ADXL355 accelerometer"
			default y

		config INCL_G104MF_ENABLE_MICROSD
			bool "Enable micro-SD card"
			default y


	endmenu
```

## ports/nucleo-f411re/Kconfig
```kconfig
config PORT_NUCLEO_F411RE
	bool "STM32 Nucleo-F411RE"

	menu "Configuraton"
		depends on PORT_NUCLEO_F411RE
		config NUCLEO_F411RE_RFM69_RADIO
			bool "RFM69 radio attached"
			default n

		config PORT_NAME
			string
			default "nucleo-f411re"

		config PLATFORM_NAME
			string
			default "cortex-m4f"
	endmenu
```

## ports/nwdaq-br28-fdc/Kconfig
```kconfig
config PORT_NWDAQ_BR28_FDC
	bool "nwDaq 8-channel bridge digitiser with AC excitation and CAN-FD interface (nwdaq-br28-fdc)"

	menu "Configuraton"
		depends on PORT_NWDAQ_BR28_FDC

		config PORT_NAME
			string
			default "nwdaq-br28-fdc"

		config PLATFORM_NAME
			string
			default "cortex-m4f"

		config MCU_FAMILY
			string
			default "stm32g4"

		config PORT_FLASH_ADDRESS
			hex
			default "0x08000000"

		config NWDAQ_BR28_FDC_CONSOLE_SPEED
			int "Serial console speed"
			default 115200
	endmenu
```

## ports/nwdaq-g201/Kconfig
```kconfig
config PORT_NWDAQ_G201
	bool "nwDaq-G201"

	menu "Configuration"
		depends on PORT_NWDAQ_G201
		config PORT_NAME
			string
			default "nwdaq-g201"

		config PLATFORM_NAME
			string
			default "cortex-m4f"

		config NWDAQ_G201_BAT_VOLTAGE
			bool "Measure battery voltage (create a sensor device)"
			default y
			select SERVICE_ADC_SENSOR

		config NWDAQ_G201_ENABLE_FLASH
			bool "Enable onboard SPI flash memory"
			default y
			select SERVICE_SPI_FLASH
			select SERVICE_FS_SPIFFS

		config NWDAQ_G201_ENABLE_RADIO
			bool "Enable onboard SX1231 radio transceiver"
			default y
			select SERVICE_RADIO_RFM69

		config NWDAQ_G201_ENABLE_LED
			bool "Enable status LED"
			default y
	endmenu
```

## ports/nwdaq-if-lpcan/Kconfig
```kconfig
config PORT_NWDAQ_IF_CANLP
	bool "Dual-port low power CAN-FD interface"

	menu "Configuraton"
		depends on PORT_NWDAQ_IF_CANLP

		config PORT_NAME
			string
			default "nwdaq-if-lpcan"

		config PLATFORM_NAME
			string
			default "cortex-m4f"

		config PORT_FLASH_ADDRESS
			hex
			default "0x08000000"

	endmenu
```

## ports/nwdaq-rtd18-fdc/Kconfig
```kconfig
config PORT_NWDAQ_RTD18_FDC
	bool "nwDaq 8-channel RTD digitiser with CAN-FD interface (nwdaq-rtd18-fdc)"

	menu "Configuraton"
		depends on PORT_NWDAQ_RTD18_FDC

		config PORT_NAME
			string
			default "nwdaq-rtd18-fdc"

		config PLATFORM_NAME
			string
			default "cortex-m4f"

		config MCU_FAMILY
			string
			default "stm32g4"

		config PORT_FLASH_ADDRESS
			hex
			default "0x08000000"

		config NWDAQ_RTD18_FDC_ENABLE_SERIAL_CONSOLE
			bool "Enable diagnostic serial console"
			default yes

		config NWDAQ_RTD18_FDC_CONSOLE_SPEED
			depends on NWDAQ_RTD18_FDC_ENABLE_SERIAL_CONSOLE
			int "Serial console speed"
			default 115200

		config NWDAQ_RTD18_FDC_ENABLE_LEDS
			bool "Enable back panel LEDs"
			default yes

		config NWDAQ_RTD18_FDC_ENABLE_FLASH
			bool "Enable NOR flash on the SPI3 interface"
			default yes
	endmenu
```

## ports/plumpot-cellular/Kconfig
```kconfig
config PORT_PLUMPOT_CELLULAR
	bool "plumpot-cellular"
	select SERVICE_STM32_RTC
	select SERVICE_STM32_SYSTEM_CLOCK
	select SERVICE_PLOCATOR

	menu "Configuration"
		depends on PORT_PLUMPOT_CELLULAR

		config PORT_NAME
			string
			default "plumpot-cellular"

		config PLATFORM_NAME
			string
			default "cortex-m4f"

		config PORT_FLASH_ADDRESS
			hex
			default "0x08000000"

		config PLUMPOT_CELLULAR_ENABLE_GSM
			bool "Enable onboard GSM modem"
			select SERVICE_GSM_QUECTEL
			default y

		config PLUMPOT_CELLULAR_MQTT_OVER_GSM
			bool "Create a default MQTT connection over the GSM modem"
			select DEFAULT_MQTT_CONNECTION
			select SERVICE_STREAM_OVER_MQTT
			select SERVICE_MQTT_SENSOR_UPLOAD
			select SERVICE_MQTT_FILE_SERVER
			select PLUMPOT_CELLULAR_ENABLE_GSM
			default y

		config PLUMPOT_CELLULAR_ENABLE_I2C_SENSORS
			bool "Enable some I2C sensors on the I2C connector"
			default n
			select SERVICE_STM32_I2C_SENSORS

		config PLUMPOT_CELLULAR_ENABLE_WATCHDOG
			bool "Enable watchdog"
			select SERVICE_STM32_WATCHDOG
			default y

		config PLUMPOT_CELLULAR_ENABLE_UXB
			bool "Enable UXB extension bus"
			select SERVICE_UXB_MASTER
			default y

		config PLUMPOT_CELLULAR_UXB_VOLTAGE
			bool "Measure UXB Vbus voltage"
			select SERVICE_STM32_ADC
			default y

		choice
			prompt "Clock speed"

			config PLUMPOT_CELLULAR_CLOCK_HSE_16MHZ
				bool "16MHz (HSE, no PLL)"

			config PLUMPOT_CELLULAR_CLOCK_HSE_84MHZ
				bool "84MHz (HSE, PLL)"
		endchoice
	endmenu
```
