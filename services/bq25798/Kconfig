## services/bq25798/Kconfig
```kconfig
config SERVICE_BQ25798
	bool "Texas Instruments BQ25798 buck-boost battery charger driver"
	default n
```

## services/bq27441/Kconfig
```kconfig
config SERVICE_BQ27441
	bool "Texas Instruments BQ27441-G1 battery fuel gauge driver"
	default n
```

## services/flash-vol-static/Kconfig
```kconfig
config SERVICE_FLASH_VOL_STATIC
	bool "Flash volumes service (static configuration)"
	default y

	config SERVICE_FLASH_VOL_STATIC_LVS_MAX
		int "Maximum number of logical volumes per flash device"
		depends on SERVICE_FLASH_VOL_STATIC
		default 8
```

## services/gpio-keypad/Kconfig
```kconfig
config SERVICE_GPIO_KEYPAD
	bool "Service implementing a keypad using GPIO inputs"
	default n
```

## services/iis2iclx/Kconfig
```kconfig
config SERVICE_INERTIAL_IIS2ICLX
	bool "ST IIS2ICLX 2 axis inclinometer"
	default n
```

## services/keypad-layout/Kconfig
```kconfig
config SERVICE_KEYPAD_LAYOUT
	bool "Service translating raw keypad events into key/counter events using a layout"
	default n
```

## services/lis2hh12/Kconfig
```kconfig
config SERVICE_INERTIAL_LIS2HH12
	bool "ST LIS2HH12 3 axis accelerometer"
	default n
```

## services/pcal6408a-gpio/Kconfig
```kconfig
config SERVICE_PCAL6408A_GPIO
	bool "Driver for GPIO over PCAL6408A expander"
	default n
```

## services/proto-conf/Kconfig
```kconfig
config SERVICE_PROTO_CONF
	bool "Remote configuration tree access protocol"
	default n

	config SERVICE_PROTO_CONF_MAX_DATAGRAM_LEN
		int "Maximum datagram size (bytes)"
		default 512
		depends on SERVICE_PROTO_CONF

	config SERVICE_PROTO_CONF_MAX_PATH_DEPTH
		int "Maximum path nesting depth"
		default 8
		depends on SERVICE_PROTO_CONF

	config SERVICE_PROTO_CONF_MAX_PATH_COMP_LEN
		int "Maximum path component string length (bytes)"
		default 32
		depends on SERVICE_PROTO_CONF

	config SERVICE_PROTO_CONF_MAX_STR_LEN
		int "Maximum string/bytestring value buffer size (bytes)"
		default 128
		depends on SERVICE_PROTO_CONF

	config SERVICE_PROTO_CONF_MAX_SIBLINGS
		int "Maximum siblings returned per walk_siblings response"
		default 16
		depends on SERVICE_PROTO_CONF
```

## services/proto-dgble/Kconfig
```kconfig
config SERVICE_PROTO_DGBLE
	bool "Tunnelling of datagrams over a BLE GATT service"
	default n

	config SERVICE_PROTO_DGBLE_DEBUG
		bool "Enable debug logging of tunnelled datagram traffic"
		default n
		depends on SERVICE_PROTO_DGBLE

	config SERVICE_PROTO_DGBLE_MAX_ENDPOINTS
		int "Maximum number of tunnelled endpoints (GATT characteristics)"
		default 4
		depends on SERVICE_PROTO_DGBLE

	config SERVICE_PROTO_DGBLE_MAX_DATAGRAM
		int "Maximum datagram payload size (bytes)"
		default 244
		depends on SERVICE_PROTO_DGBLE

	config SERVICE_PROTO_DGBLE_RX_QUEUE_LEN
		int "Number of inbound datagrams buffered per endpoint"
		default 4
		depends on SERVICE_PROTO_DGBLE
```

## services/proto-dgstream/Kconfig
```kconfig
config SERVICE_PROTO_DGSTREAM
	bool "Framing of datagrams over a Stream using inter-frame gaps"
	default n

	config SERVICE_PROTO_DGSTREAM_TX_GAP_MS
		int "Inter-frame gap kept idle on the medium after transmitting a datagram (ms)"
		default 2
		depends on SERVICE_PROTO_DGSTREAM

	config SERVICE_PROTO_DGSTREAM_RX_TIMEOUT_MS
		int "Stream read timeout used to detect the end of a received frame (ms)"
		default 2
		depends on SERVICE_PROTO_DGSTREAM
```

## services/proto-dgtext/Kconfig
```kconfig
config SERVICE_PROTO_DGTEXT
	bool "Transport of arbitrary datagrams over a Stream as plain text lines"
	default n

	config SERVICE_PROTO_DGTEXT_MAX_DATAGRAM_LEN
		int "Maximum datagram payload size (bytes)"
		default 256
		depends on SERVICE_PROTO_DGTEXT
```

## services/proto-stream/Kconfig
```kconfig
config SERVICE_PROTO_STREAM
	bool "Reliable transport of stream data over datagrams"
	default n
```

## services/remote-interface-ble/Kconfig
```kconfig
config SERVICE_REMOTE_INTERFACE_BLE
	bool "BLE GATT transport for RemoteInterface services"
	default n

	config SERVICE_REMOTE_INTERFACE_BLE_DEBUG
		bool "Enable debug logging of control requests and data traffic"
		default n
		depends on SERVICE_REMOTE_INTERFACE_BLE

	config SERVICE_REMOTE_INTERFACE_BLE_CHANNELS
		int "Number of data channels (concurrently open sessions)"
		default 4
		range 1 63
		depends on SERVICE_REMOTE_INTERFACE_BLE

	config SERVICE_REMOTE_INTERFACE_BLE_RX_QUEUE_LEN
		int "Number of inbound data fragments buffered"
		default 8
		depends on SERVICE_REMOTE_INTERFACE_BLE
```

## services/remote-interface-proxy/Kconfig
```kconfig
config SERVICE_REMOTE_INTERFACE_PROXY
	bool "Proxy exporting legacy Datagram protocol handlers as a RemoteInterface"
	default n
```

## services/shtc3/Kconfig
```kconfig
config SERVICE_SHTC3
	bool "SHTC3 temperature and humidity sensor driver"
	default n
```

## services/st67w611/Kconfig
```kconfig
config SERVICE_ST67W611
	bool "STMicroelectronics ST67W611M1 Wi-Fi/BLE combo module driver"
	default n

	config SERVICE_ST67W611_DEBUG
		bool "Enable debug logging of AT command/response/URC traffic"
		default n
		depends on SERVICE_ST67W611

	comment "BLE connection parameters (renegotiated on every connection)"
		depends on SERVICE_ST67W611

	config SERVICE_ST67W611_CONN_PARAM_MIN_INTERVAL
		int "Minimum connection interval, in units of 1.25 ms"
		default 6
		range 6 3200
		depends on SERVICE_ST67W611
		help
		  Lower bound of the connection interval requested when a central connects. A shorter interval
		  cuts the per-datagram round-trip time (e.g. for a flash transfer over the datagram tunnel) at
		  the cost of higher power draw. 6 is the 7.5 ms minimum allowed by BLE.

	config SERVICE_ST67W611_CONN_PARAM_MAX_INTERVAL
		int "Maximum connection interval, in units of 1.25 ms"
		default 6
		range 6 3200
		depends on SERVICE_ST67W611
		help
		  Upper bound of the requested connection interval. Must be at least the minimum above.

	config SERVICE_ST67W611_CONN_PARAM_LATENCY
		int "Peripheral latency, in skippable connection events"
		default 0
		range 0 499
		depends on SERVICE_ST67W611
		help
		  How many connection events the peripheral may skip. Keep at 0 for lowest latency.

	config SERVICE_ST67W611_CONN_PARAM_TIMEOUT
		int "Supervision timeout, in units of 10 ms"
		default 500
		range 10 3200
		depends on SERVICE_ST67W611
		help
		  Link supervision timeout. Must comfortably exceed the maximum interval times the latency.
```

## services/syslog/Kconfig
```kconfig
config SERVICE_SYSLOG
	bool "Syslog-style system-wide logging service"
	default y
```
