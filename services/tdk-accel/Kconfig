## services/tdk-accel/Kconfig
```kconfig
config SERVICE_INERTIAL_TDK_ACCEL
	bool "Generic driver for TDK accelerometers and gyroscopes"
	default n
```

## services/tmp1826/Kconfig
```kconfig
config SERVICE_TMP1826
	bool "TMP1826 1-Wire temperature sensor and EEPROM driver"
	default n

if SERVICE_TMP1826
	config SERVICE_TMP1826_EEPROM_RETRIES
		int "Number of EEPROM operation retries on failure"
		default 3
endif
```

## services/uart-ow/Kconfig
```kconfig
config SERVICE_UART_OW
	bool "1-Wire bus master over a UART peripheral"
	default n
```
